## build/Kconfig/boards/Kconfig.defconfig
```kconfig
# Load Zephyr board defconfig descriptions.
osource "C:/ncs/v3.2.4/zephyr/boards/seeed/xiao_nrf54l15/Kconfig.defconfig"
```

## build/swdm031_img_xfer-main/Kconfig/Kconfig.shield
```kconfig
osource "C:/ncs/v3.2.4/nrf/boards/shields/*/Kconfig.shield"
osource "C:/Users/denar/Desktop/swdm031_img_xfer-main/usp_preview/usp_zephyr/boards/shields/*/Kconfig.shield"
```

## build/swdm031_img_xfer-main/Kconfig/boards/Kconfig.sysbuild
```kconfig
# Load Sysbuild board Kconfig descriptions.
osource "C:/ncs/v3.2.4/zephyr/boards/seeed/xiao_nrf54l15/Kconfig.sysbuild"
```
